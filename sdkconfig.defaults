## sdkconfig.defaults
```kconfig
# Logger configuration.
CONFIG_LOG_MAXIMUM_LEVEL_VERBOSE=y
CONFIG_LOG_MAXIMUM_LEVEL=5
CONFIG_LOG_COLORS=n
CONFIG_LOG_TIMESTAMP_SOURCE_SYSTEM=y
# OS/SDK configuration.
CONFIG_AUTOSTART_ARDUINO=n
CONFIG_FREERTOS_HZ=1000
# Hardware configuration.
CONFIG_ESP_DEFAULT_CPU_FREQ_MHZ_80=y
CONFIG_ESP_DEFAULT_CPU_FREQ_MHZ=80
# Flasher configuration.
CONFIG_ESPTOOLPY_FLASHSIZE_4MB=y
CONFIG_ESPTOOLPY_FLASHSIZE="4MB"
CONFIG_ESPTOOLPY_HEADER_FLASHSIZE_UPDATE=y
```
